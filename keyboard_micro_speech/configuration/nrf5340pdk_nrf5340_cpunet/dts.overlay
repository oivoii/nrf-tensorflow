/ {
	chosen {
		/*
		 * In some default configurations within the nRF Connect SDK,
		 * e.g. on nRF52840 and nRF9160, the chosen zephyr,entropy node
		 * is &cryptocell. This devicetree overlay ensures that default
		 * is overridden wherever it is set, as this application uses
		 * the RNG node for entropy exclusively.
		 */
		zephyr,entropy = &rng;
	};
};
